## prj.conf
```kconfig
# Stacks and heaps
CONFIG_MAIN_STACK_SIZE=4096
CONFIG_HEAP_MEM_POOL_SIZE=16384

CONFIG_BOOTLOADER_MCUBOOT=y

# Logging via RTT
CONFIG_LOG=y
CONFIG_LOG2_MODE_IMMEDIATE=y
CONFIG_LOG_BACKEND_UART=n
CONFIG_USE_SEGGER_RTT=y
CONFIG_LOG_BACKEND_RTT=y
# Tracing via SEGGER SYSTEMVIEW
CONFIG_TRACING=y
CONFIG_SEGGER_SYSTEMVIEW=y

# newlibc
CONFIG_NEWLIB_LIBC=y

CONFIG_NO_OPTIMIZATIONS=y
#CONFIG_DEBUG_OPTIMIZATIONS=y
```

## src/main.c
```c
#include <zephyr.h>
#include <logging/log.h>

LOG_MODULE_REGISTER(main);

void main(void)
{
	while(1){
		k_msleep(1000);
	}
}
```
